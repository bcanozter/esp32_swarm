## main/Kconfig.projbuild
```kconfig
menu "ESP Mesh Lite Configuration"

    config APP_DEBUG
        bool "App Debug"
        default n
        help
            Enable screen printing for debugging purposes.
    config MESH_ROOT
        select JOIN_MESH_IGNORE_ROUTER_STATUS
        bool "Root device"
        default n
        help
            Configure the root device type.

    config MESH_ID
        int "Mesh ID"
        range 1 99
        default 77
        help
            Mesh network ID.

    config MESH_CHANNEL
        int "Mesh network channel"
        range 1 14
        default 11
        help
            Mesh network channel.

    menu "Scan AP Configuration"

        config EXAMPLE_SCAN_LIST_SIZE
            int "Max size of scan list"
            range 0 20
            default 10
            help
                The size of array that will be used to retrieve the list of access points.

        config EXAMPLE_USE_SCAN_CHANNEL_BITMAP
            bool "Scan only non overlapping channels using Channel bitmap"
            default 0
            help
                Enable this to scanMESH_ROOT only the non overlapping channels i.e 1,6,11 by mentioning a channel bitmap
                in scan config. If you wish to scan a different set of specific channels, please edit the channel_list
                array in scan.c. Channels for a 2.4 ghz network range should range from 1-14.
    endmenu
    
    menu "ESPNOW Configuration"

        config ESPNOW_PMK
            string "ESPNOW primary master key"
            default "pmk1234567890123"
            help
                ESPNOW primary master for the example to use. The length of ESPNOW primary master must be 16 bytes.

        config ESPNOW_CHANNEL
            int "Channel"
            default 1
            range 0 14
            help
                The channel on which sending and receiving ESPNOW data.

    endmenu

    menu "WiFi Station Configuration"
    config ENABLE_WIFI_STA
        bool
        default n
        prompt "Enable WiFi Station"

    if ENABLE_WIFI_STA
        config ESP_WIFI_SSID
            string "WiFi SSID"
            default "myssid"
            depends on ENABLE_WIFI_STA
            help
                SSID (network name) for the example to connect to.

        config ESP_WIFI_PASSWORD
            string "WiFi Password"
            default "mypassword"
            depends on ENABLE_WIFI_STA
            help
                WiFi password (WPA or WPA2) for the example to use.

        choice ESP_WIFI_SAE_MODE
            prompt "WPA3 SAE mode selection"
            default ESP_STATION_EXAMPLE_WPA3_SAE_PWE_BOTH
            depends on ENABLE_WIFI_STA
            help
                Select mode for SAE as Hunt and Peck, H2E or both.
            config ESP_STATION_EXAMPLE_WPA3_SAE_PWE_HUNT_AND_PECK
                bool "HUNT AND PECK"
            config ESP_STATION_EXAMPLE_WPA3_SAE_PWE_HASH_TO_ELEMENT
                bool "H2E"
                depends on ESP_WIFI_ENABLE_SAE_H2E
            config ESP_STATION_EXAMPLE_WPA3_SAE_PWE_BOTH
                bool "BOTH"
                depends on ESP_WIFI_ENABLE_SAE_H2E
        endchoice

        config ESP_WIFI_PW_ID
            string "PASSWORD IDENTIFIER"
            depends on  (ESP_STATION_EXAMPLE_WPA3_SAE_PWE_HASH_TO_ELEMENT|| ESP_STATION_EXAMPLE_WPA3_SAE_PWE_BOTH) && ENABLE_WIFI_STA
            default ""
            help
                password identifier for SAE H2E

        config ESP_MAXIMUM_RETRY
            int "Maximum retry"
            default 5
            depends on ENABLE_WIFI_STA
            help
                Set the Maximum retry to avoid station reconnecting to the AP unlimited when the AP is really inexistent.

        choice ESP_WIFI_SCAN_AUTH_MODE_THRESHOLD
            prompt "WiFi Scan auth mode threshold"
            default ESP_WIFI_AUTH_WPA2_PSK
            depends on ENABLE_WIFI_STA
            help
                The weakest authmode to accept in the scan mode.
                This value defaults to ESP_WIFI_AUTH_WPA2_PSK in case password is present and ESP_WIFI_AUTH_OPEN is used.
                Please select ESP_WIFI_AUTH_WEP/ESP_WIFI_AUTH_WPA_PSK in case AP is operating in WEP/WPA mode.

            config ESP_WIFI_AUTH_OPEN
                bool "OPEN"
            config ESP_WIFI_AUTH_WEP
                bool "WEP"
            config ESP_WIFI_AUTH_WPA_PSK
                bool "WPA PSK"
            config ESP_WIFI_AUTH_WPA2_PSK
                bool "WPA2 PSK"
            config ESP_WIFI_AUTH_WPA_WPA2_PSK
                bool "WPA/WPA2 PSK"
            config ESP_WIFI_AUTH_WPA3_PSK
                bool "WPA3 PSK"
            config ESP_WIFI_AUTH_WPA2_WPA3_PSK
                bool "WPA2/WPA3 PSK"
            config ESP_WIFI_AUTH_WAPI_PSK
                bool "WAPI PSK"
        endchoice
    endif
    endmenu
endmenu
```

## sdkconfig.defaults.esp32s3
```kconfig
# Override some defaults in mesh application project.

#
# App Specific
#
CONFIG_MESH_ROOT=y
CONFIG_APP_DEBUG=y
CONFIG_MESH_ID=69
CONFIG_MESH_CHANNEL=11
CONFIG_ESPNOW_CHANNEL=1
CONFIG_ENABLE_WIFI_STA=n

#
# Partition Table
#
CONFIG_PARTITION_TABLE_SINGLE_APP_LARGE=y
# end of Partition Table

#
# FreeRTOS
#
CONFIG_FREERTOS_HZ=1000
CONFIG_FREERTOS_TIMER_TASK_STACK_DEPTH=3072
CONFIG_FREERTOS_USE_TRACE_FACILITY=y
CONFIG_FREERTOS_USE_STATS_FORMATTING_FUNCTIONS=y
CONFIG_FREERTOS_VTASKLIST_INCLUDE_COREID=y
CONFIG_FREERTOS_GENERATE_RUN_TIME_STATS=y

#
# ESP32-specific
#
CONFIG_ESP_TASK_WDT_PANIC=y
CONFIG_ESP_TASK_WDT_TIMEOUT_S=10
CONFIG_ESP_TIMER_TASK_STACK_SIZE=4096

# LWIP
CONFIG_LWIP_IP_FORWARD=y
CONFIG_LWIP_IPV4_NAPT=y

CONFIG_MESH_LITE_ENABLE=y
CONFIG_MESH_LITE_NODE_INFO_REPORT=y

CONFIG_BRIDGE_SOFTAP_SSID_END_WITH_THE_MAC=y
```
